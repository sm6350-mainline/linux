## Documentation/devicetree/bindings/display/panel/himax,hx83112f.yaml
```yaml
# SPDX-License-Identifier: GPL-2.0-only OR BSD-2-Clause
%YAML 1.2
---
$id: http://devicetree.org/schemas/display/panel/himax,hx83112f.yaml#
$schema: http://devicetree.org/meta-schemas/core.yaml#

title: Himax HX83112F-based DSI display panels

maintainers:
  - Saalim Quadri <danascape@gmail.com>

description:
  The Himax HX83112F is a generic DSI Panel IC used to control
  LCD panels.

allOf:
  - $ref: panel-common.yaml#

properties:
  compatible:
    contains:
      const: tianma,hx83112f-fhd

  reg:
    maxItems: 1

  vddio-supply:
    description: I/O voltage rail

  vsn-supply:
    description: Positive source voltage rail

  vsp-supply:
    description: Negative source voltage rail

required:
  - compatible
  - reg
  - reset-gpios
  - vddio-supply
  - vsn-supply
  - vsp-supply
  - port

unevaluatedProperties: false

examples:
  - |
    #include <dt-bindings/gpio/gpio.h>

    dsi {
        #address-cells = <1>;
        #size-cells = <0>;

        panel@0 {
            compatible = "tianma,hx83112f-fhd";
            reg = <0>;

            reset-gpios = <&tlmm 75 GPIO_ACTIVE_LOW>;

            vddio-supply = <&vreg_l8c>;
            vsn-supply = <&pm6150l_lcdb_ncp>;
            vsp-supply = <&pm6150l_lcdb_ldo>;

            port {
                panel_in_0: endpoint {
                    remote-endpoint = <&dsi0_out>;
                };
            };
        };
    };

...
```

## Documentation/devicetree/bindings/sound/awinic,aw88264.yaml
```yaml
# SPDX-License-Identifier: (GPL-2.0-only OR BSD-2-Clause)
%YAML 1.2
---
$id: http://devicetree.org/schemas/sound/awinic,aw88264.yaml#
$schema: http://devicetree.org/meta-schemas/core.yaml#

title: Awinic AW88264 Smart Audio Amplifier

maintainers:
  - Tim auf der Landwehr <tadl-git@taufderl.de>

description: >
  The Awinic AW88264 is an I2S input smart speaker amplifier.

  It is a separate binding from awinic,aw88395.yaml rather than another entry
  in that file's compatible list, because it is a separate generation of the
  part: it reports chip id 0x1852 where every device covered there reports
  0x2049 or above, and its register map diverges accordingly. It also has
  none of that family's firmware-container properties, because the driver
  loads no container.

properties:
  compatible:
    const: awinic,aw88264

  reg:
    maxItems: 1

  '#sound-dai-cells':
    const: 0

  reset-gpios:
    maxItems: 1

required:
  - compatible
  - reg
  - '#sound-dai-cells'

allOf:
  - $ref: dai-common.yaml#

unevaluatedProperties: false

examples:
  - |
    #include <dt-bindings/gpio/gpio.h>
    i2c {
        #address-cells = <1>;
        #size-cells = <0>;

        audio-codec@34 {
            compatible = "awinic,aw88264";
            reg = <0x34>;
            #sound-dai-cells = <0>;
            reset-gpios = <&gpio 12 GPIO_ACTIVE_HIGH>;
        };
    };
```
